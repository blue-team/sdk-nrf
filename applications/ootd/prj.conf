## CMakeLists.txt
```
# SPDX-License-Identifier: Apache-2.0

list(APPEND ZEPHYR_EXTRA_MODULES
  ${CMAKE_CURRENT_SOURCE_DIR}/opt3001_module)

cmake_minimum_required(VERSION 3.20.0)
find_package(Zephyr REQUIRED HINTS $ENV{ZEPHYR_BASE})

project(ootd2)
#add_subdirectory(drivers)

FILE(GLOB app_sources src/*.c)
target_sources(app PRIVATE ${app_sources})
```

## prj.conf
```kconfig
CONFIG_PRINTK=y
CONFIG_GPIO=y
CONFIG_I2C=y
CONFIG_SENSOR=y

CONFIG_LOG=y
CONFIG_SENSOR_LOG_LEVEL_INF=y
CONFIG_I2C_LOG_LEVEL_INF=y

CONFIG_PM_DEVICE=n

CONFIG_CONSOLE=y
CONFIG_RTT_CONSOLE=y
CONFIG_USE_SEGGER_RTT=y
```

## src/main.c
```c
#include <zephyr/kernel.h>
#include <zephyr/device.h>
#include <zephyr/drivers/sensor.h>
#include <zephyr/sys/printk.h>
#include "als.h"

void main(void)
{
	struct sensor_value intensity;
	printk("OOTD -  Ambient Light Sensor sample code\n");
	als_init(DEVICE_DT_GET(DT_ALIAS(als)));

	while (true) {
		if (als_read(&intensity))
			printk("Error Reading Ambient Light Sensor");
		printk("Ambient Light Intensity %d\n", intensity.val1);
		k_sleep(K_MSEC(1000));
	}
}
```

## src/als.c
```c
#include <zephyr/drivers/sensor.h>
#include <zephyr/device.h>
#include <zephyr/sys/printk.h>

const struct device *dev;

int als_read (struct sensor_value *intensity){
    if (dev == NULL)
        return -EINVAL;

        // Fetch sensor data
    if (sensor_sample_fetch(dev)) {
		printk("sensor_sample_fetch failed\n");
        return -EIO;
	}
        
    // Read sensor ambient light intensity
    if (sensor_channel_get(dev, SENSOR_CHAN_LIGHT, intensity)){
       	printk("sensor_channel_get failed\n");
        return -EIO; 
    };
    return 0;
}

int als_init (const struct device *target_device){
	printk("Ambient Light Sensor Init\n");

    dev = target_device;
    if (dev == NULL)
        return -EINVAL;

    // Check device ready
	if (!device_is_ready(dev)) {
		printk("sensor: device not ready.\n");
		return -ENODEV;
	}

    struct sensor_value intensity;
    if(als_read(&intensity)){
		printk("als_read failed\n");
        return -EIO;
	}

    return 0;
}
```

## src/als.h
```c
#ifndef ALS_H
#define ALS_H

int als_init (const struct device *target_device);
int als_read (struct sensor_value *intensity);

#endif //ALS_H
```
